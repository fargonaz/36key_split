## boards/shields/36key_split/Kconfig.defconfig
```kconfig
if SHIELD_SPLIT_DONGLE

config ZMK_KEYBOARD_NAME
    default "36KEY_SPLIT"

config ZMK_SPLIT_BLE_ROLE_CENTRAL
#config ZMK_SPLIT_ROLE_CENTRAL
    default y

config ZMK_USB
    default y

endif

if SHIELD_36KEY_SPLIT_LEFT || SHIELD_36KEY_SPLIT_RIGHT || SHIELD_SPLIT_DONGLE

config ZMK_SPLIT
    default y

config ZMK_BLE
    default y

endif
```

## boards/shields/Kconfig.shield
```kconfig
# Copyright (c) 2020 Pete Johanson
# SPDX-License-Identifier: MIT

config SHIELD_36KEY_SPLIT_LEFT
    def_bool $(shields_list_contains,36key_split_left)

config SHIELD_36KEY_SPLIT_RIGHT
    def_bool $(shields_list_contains,36key_split_right)

config SHIELD_SPLIT_DONGLE
    def_bool $(shields_list_contains,split_dongle)
```

## config/west.yml
```yaml
manifest:
  remotes:
    - name: zmkfirmware
      url-base: https://github.com/petejohanson
    - name: dhruvinsh
      url-base: https://github.com/dhruvinsh
    - name: urob
      url-base: https://github.com/urob
    # Additional modules containing boards/shields/custom code can be listed here as well
    # See https://docs.zephyrproject.org/3.2.0/develop/west/manifest.html#projects
  projects:
    - name: zmk
      remote: zmkfirmware
      revision: feat/pointers-with-input-processors
      import: app/west.yml
    - name: zmk-tri-state
      remote: dhruvinsh
      revision: main
    - name: zmk-helpers
      remote: urob
      revision: main
      path: modules/helper
  self:
    path: config
```
